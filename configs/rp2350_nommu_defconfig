## configs/rp2350_nommu_defconfig
```kconfig
BR2_riscv=y
BR2_riscv_custom=y
BR2_RISCV_ISA_RVM=y
BR2_RISCV_ISA_RVA=y
BR2_RISCV_ISA_RVC=y
BR2_RISCV_32=y
# BR2_RISCV_USE_MMU is not set
# BR2_UCLIBC_INSTALL_UTILS is not set
BR2_GLOBAL_PATCH_DIR="board/qemu/patches"
BR2_DOWNLOAD_FORCE_CHECK_HASHES=y
BR2_ROOTFS_OVERLAY="/home/developer/iotahydrae/rp2350-linux/s5/00_ram-trim/overlay"
BR2_PACKAGE_BUSYBOX_CONFIG="package/busybox/busybox-rp2350.config"
BR2_TARGET_ROOTFS_CPIO=y
BR2_PACKAGE_HOST_KMOD=y
```
